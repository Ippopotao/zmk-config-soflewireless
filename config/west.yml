## config/west.yml
```yaml
manifest:
  remotes:
    - name: zmkfirmware
      url-base: https://github.com/zmkfirmware
    - name: joelspadin
      url-base: https://github.com/joelspadin
  projects:
    - name: zmk
      remote: zmkfirmware
      revision: main
      import: app/west.yml
    # Deutsches Layout (DE_* Keycodes)
    - name: zmk-locales
      remote: joelspadin
      revision: main
  self:
    path: config
    
```
